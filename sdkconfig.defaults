## sdkconfig.defaults
```kconfig
CONFIG_HUB75_BOARD_CUSTOM=y
CONFIG_HUB75_PANEL_WIDTH=64
CONFIG_HUB75_PANEL_HEIGHT=32
CONFIG_HUB75_LAYOUT_ROWS=1
CONFIG_HUB75_LAYOUT_COLS=1
CONFIG_HUB75_WIRING_STANDARD=y
CONFIG_HUB75_PIN_R1=4
CONFIG_HUB75_PIN_G1=5
CONFIG_HUB75_PIN_B1=6
CONFIG_HUB75_PIN_R2=7
CONFIG_HUB75_PIN_G2=15
CONFIG_HUB75_PIN_B2=16
CONFIG_HUB75_PIN_A=18
CONFIG_HUB75_PIN_B=8
CONFIG_HUB75_PIN_C=3
CONFIG_HUB75_PIN_D=42
CONFIG_HUB75_PIN_E=9
CONFIG_HUB75_PIN_LAT=40
CONFIG_HUB75_PIN_OE=2
CONFIG_HUB75_PIN_CLK=41
CONFIG_LV_FONT_UNSCII_16=y
CONFIG_LV_FONT_UNSCII_8=y
CONFIG_LV_USE_QRCODE=y

# Custom partition table for larger app size
CONFIG_PARTITION_TABLE_CUSTOM=y
CONFIG_PARTITION_TABLE_CUSTOM_FILENAME="partitions.csv"

# Enable binary compression to reduce app size
CONFIG_APP_COMPRESS_LEVEL_6=y

# BLE transport for Wi-Fi provisioning (protocomm)
CONFIG_BT_ENABLED=y
CONFIG_BT_BLE_ENABLED=y
CONFIG_BT_NIMBLE_ENABLED=y
CONFIG_BT_NIMBLE_MEM_ALLOC_MODE_DEFAULT=y
# CONFIG_BT_NIMBLE_MEM_ALLOC_MODE_INTERNAL is not set
CONFIG_BT_NIMBLE_ROLE_PERIPHERAL=y
# CONFIG_BT_NIMBLE_ROLE_CENTRAL is not set
# CONFIG_BT_NIMBLE_ROLE_BROADCASTER is not set
# CONFIG_BT_NIMBLE_ROLE_OBSERVER is not set
# CONFIG_BT_NIMBLE_GATT_CLIENT is not set
CONFIG_BT_NIMBLE_GATT_SERVER=y
# CONFIG_BT_NIMBLE_SECURITY_ENABLE is not set
CONFIG_BT_NIMBLE_MAX_BONDS=1
CONFIG_BT_NIMBLE_MAX_CONNECTIONS=1
CONFIG_BT_NIMBLE_MAX_CCCDS=4
CONFIG_BT_NIMBLE_ATT_PREFERRED_MTU=128
CONFIG_BT_NIMBLE_ATT_MAX_PREP_ENTRIES=16
# CONFIG_BT_NIMBLE_PROX_SERVICE is not set
# CONFIG_BT_NIMBLE_ANS_SERVICE is not set
# CONFIG_BT_NIMBLE_CTS_SERVICE is not set
# CONFIG_BT_NIMBLE_HTP_SERVICE is not set
# CONFIG_BT_NIMBLE_IPSS_SERVICE is not set
# CONFIG_BT_NIMBLE_TPS_SERVICE is not set
# CONFIG_BT_NIMBLE_IAS_SERVICE is not set
# CONFIG_BT_NIMBLE_LLS_SERVICE is not set
# CONFIG_BT_NIMBLE_SPS_SERVICE is not set
# CONFIG_BT_NIMBLE_HR_SERVICE is not set
# CONFIG_BT_NIMBLE_BAS_SERVICE is not set
# CONFIG_BT_NIMBLE_DIS_SERVICE is not set
```
